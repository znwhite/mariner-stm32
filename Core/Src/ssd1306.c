#include "ssd1306.h"
#include <stdarg.h>

// I2C handle - adjust this to match your CubeMX configuration
extern I2C_HandleTypeDef hi2c1; // Change to hi2c2 if you used I2C2

// Screen buffer
static uint8_t SSD1306_Buffer[SSD1306_WIDTH * SSD1306_HEIGHT / 8];
static uint8_t SSD1306_X = 0, SSD1306_Y = 0;

// Simple 8x8 font
const uint8_t Font8x8[][8] = {
    {0x00, 0x00, 0x00, 0x00, 0x00, 0x00, 0x00, 0x00}, // space
    {0x00, 0x00, 0x06, 0x5F, 0x5F, 0x06, 0x00, 0x00}, // !
    {0x00, 0x03, 0x03, 0x00, 0x03, 0x03, 0x00, 0x00}, // "
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    {0x4C, 0x64, 0x74, 0x5C, 0x4C, 0x64, 0x00, 0x00}, // z
};

void SSD1306_WriteCommand(uint8_t byte) {
    HAL_I2C_Mem_Write(&hi2c1, SSD1306_I2C_ADDR << 1, 0x00, 1, &byte, 1, HAL_MAX_DELAY);
}

void SSD1306_Init(void) {
    HAL_Delay(500);

    // Initialization sequence
    SSD1306_WriteCommand(0xAE); // Display off
    SSD1306_WriteCommand(0x20); // Set Memory Addressing Mode
    SSD1306_WriteCommand(0x10); // Horizontal Addressing Mode
    SSD1306_WriteCommand(0xB0); // Set Page Start Address
    SSD1306_WriteCommand(0xC8); // Set COM Output Scan Direction
    SSD1306_WriteCommand(0x00); // Set low column address
    SSD1306_WriteCommand(0x10); // Set high column address
    SSD1306_WriteCommand(0x40); // Set start line address
    SSD1306_WriteCommand(0x81); // Set contrast control register
    SSD1306_WriteCommand(0xFF);
    SSD1306_WriteCommand(0xA1); // Set segment re-map
    SSD1306_WriteCommand(0xA6); // Set normal display
    SSD1306_WriteCommand(0xA8); // Set multiplex ratio
    SSD1306_WriteCommand(0x3F);
    SSD1306_WriteCommand(0xA4); // Output follows RAM content
    SSD1306_WriteCommand(0xD3); // Set display offset
    SSD1306_WriteCommand(0x00); // No offset
    SSD1306_WriteCommand(0xD5); // Set display clock divide ratio
    SSD1306_WriteCommand(0xF0);
    SSD1306_WriteCommand(0xD9); // Set pre-charge period
    SSD1306_WriteCommand(0x22);
    SSD1306_WriteCommand(0xDA); // Set com pins hardware configuration
    SSD1306_WriteCommand(0x12);
    SSD1306_WriteCommand(0xDB); // Set vcomh
    SSD1306_WriteCommand(0x20);
    SSD1306_WriteCommand(0x8D); // Set DC-DC enable
    SSD1306_WriteCommand(0x14);
    SSD1306_WriteCommand(0xAF); // Turn on display

    SSD1306_Clear();
}

void SSD1306_Fill(SSD1306_COLOR color) {
    memset(SSD1306_Buffer, (color == Black) ? 0x00 : 0xFF, sizeof(SSD1306_Buffer));
}

void SSD1306_UpdateScreen(void) {
    for (uint8_t i = 0; i < 8; i++) {
        SSD1306_WriteCommand(0xB0 + i); // Set page address
        SSD1306_WriteCommand(0x00);     // Set lower column
        SSD1306_WriteCommand(0x10);     // Set higher column

        HAL_I2C_Mem_Write(&hi2c1, SSD1306_I2C_ADDR << 1, 0x40, 1,
                         &SSD1306_Buffer[SSD1306_WIDTH * i], SSD1306_WIDTH, HAL_MAX_DELAY);
    }
}

void SSD1306_DrawPixel(uint8_t x, uint8_t y, SSD1306_COLOR color) {
    if (x >= SSD1306_WIDTH || y >= SSD1306_HEIGHT) return;

    if (color == White) {
        SSD1306_Buffer[x + (y / 8) * SSD1306_WIDTH] |= 1 << (y % 8);
    } else {
        SSD1306_Buffer[x + (y / 8) * SSD1306_WIDTH] &= ~(1 << (y % 8));
    }
}

void SSD1306_GotoXY(uint8_t x, uint8_t y) {
    SSD1306_X = x;
    SSD1306_Y = y;
}

void SSD1306_Puts(char* str, SSD1306_COLOR color) {
    while (*str) {
        if (SSD1306_X + 8 > SSD1306_WIDTH) {
            SSD1306_X = 0;
            SSD1306_Y += 8;
            if (SSD1306_Y + 8 > SSD1306_HEIGHT) break;
        }

        if (*str >= 32 && *str <= 126) {
            for (int i = 0; i < 8; i++) {
                uint8_t line = Font8x8[*str - 32][i];
                for (int j = 0; j < 8; j++) {
                    if (line & (1 << j)) {
                        SSD1306_DrawPixel(SSD1306_X + i, SSD1306_Y + j, color);
                    } else {
                        SSD1306_DrawPixel(SSD1306_X + i, SSD1306_Y + j, !color);
                    }
                }
            }
        }
        SSD1306_X += 8;
        str++;
    }
}

void SSD1306_Clear(void) {
    SSD1306_Fill(Black);
    SSD1306_UpdateScreen();
    SSD1306_GotoXY(0, 0);
}

void SSD1306_Printf(uint8_t x, uint8_t y, const char* format, ...) {
    char buffer[64];
    va_list args;
    va_start(args, format);
    vsnprintf(buffer, sizeof(buffer), format, args);
    va_end(args);

    SSD1306_GotoXY(x, y);
    SSD1306_Puts(buffer, White);
}
